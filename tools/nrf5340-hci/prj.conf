## CMakeLists.txt
```
# SPDX-License-Identifier: Apache-2.0
# nRF5340 as a USB HCI controller for BlueCaster's Auracast (four BIGs).
# Zephyr's hci_usb sample (nRF Connect SDK v3.4.1) with the USB HCI class
# replaced by src/bt_hci_iso.c, which passes HCI ISO data on the bulk pipe.

cmake_minimum_required(VERSION 3.20.0)
find_package(Zephyr REQUIRED HINTS $ENV{ZEPHYR_BASE})
project(bluecaster_nrf5340_hci)

include(${ZEPHYR_BASE}/samples/subsys/usb/common/common.cmake)
target_sources(app PRIVATE src/main.c src/bt_hci_iso.c)
```

## Kconfig
```
# SPDX-License-Identifier: Apache-2.0

config BLUECASTER_TRACE
	bool "ISO counters on the console (UART, J-Link VCOM)"

source "samples/subsys/usb/common/Kconfig.sample_usbd"

source "Kconfig.zephyr"
```

## sysbuild.conf
```
# The network core runs hci_ipc with the open Zephyr controller
# (sysbuild/hci_ipc.conf, snippet bt-ll-sw-split in sysbuild.cmake)
SB_CONFIG_NETCORE_HCI_IPC=y
```

## prj.conf
```kconfig
# The hci_usb sample's settings, with BlueCaster's USB HCI class
# (src/bt_hci_iso.c) instead of CONFIG_USBD_BT_HCI
CONFIG_BT=y
CONFIG_BT_HCI_RAW=y
# Console on the J-Link VCOM, for the trace (BLUECASTER_TRACE)
CONFIG_SERIAL=y
CONFIG_CONSOLE=y
CONFIG_UART_CONSOLE=y
CONFIG_LOG=y
CONFIG_LOG_DEFAULT_LEVEL=2
CONFIG_BLUECASTER_TRACE=y

CONFIG_USB_DEVICE_STACK_NEXT=y
CONFIG_CDC_ACM_SERIAL_INITIALIZE_AT_BOOT=n
# 2FE3:000B, known to BlueCaster
CONFIG_SAMPLE_USBD_PID=0x000B
CONFIG_SAMPLE_USBD_PRODUCT="Zephyr USBD BT HCI"
CONFIG_USBD_BT_HCI=n

# ISO over the HCI (BlueCaster sends the BIS SDUs as HCI ISO data)
CONFIG_BT_ISO_BROADCASTER=y
CONFIG_BT_ISO_MAX_CHAN=4
CONFIG_BT_ISO_TX_BUF_COUNT=12
CONFIG_BT_ISO_TX_MTU=251
CONFIG_BT_BUF_EVT_RX_COUNT=16
CONFIG_BT_BUF_CMD_TX_SIZE=255
CONFIG_BT_BUF_EVT_RX_SIZE=255
CONFIG_BT_BUF_ACL_TX_SIZE=251
CONFIG_BT_BUF_ACL_RX_SIZE=255
```

## src/main.c
```c
/*
 * Copyright (c) 2018 Intel Corporation
 *
 * SPDX-License-Identifier: Apache-2.0
 */

#include <zephyr/kernel.h>
#include <zephyr/sys/printk.h>
#include <zephyr/usb/usbd.h>

#include <sample_usbd.h>

int main(void)
{
	struct usbd_context *sample_usbd;
	int ret;

	sample_usbd = sample_usbd_setup_device(NULL);
	if (sample_usbd == NULL) {
		printk("Failed to initialize USB device");
		return -ENODEV;
	}

	/*
	 * Wireless Controller / RF / Bluetooth (E0/01/01) on the device, as a
	 * Bluetooth dongle has: with the sample's 00/00/00 and two interfaces
	 * Windows loads its composite driver and puts the HCI on a child node
	 * (MI_00), which BlueCaster does not list as an adapter.
	 */
	usbd_device_set_code_triple(sample_usbd, USBD_SPEED_FS, 0xE0, 0x01, 0x01);

	ret = usbd_init(sample_usbd);
	if (ret != 0) {
		printk("Failed to initialize device support");
		return -ENODEV;
	}

	ret = usbd_enable(sample_usbd);
	if (ret != 0) {
		printk("Failed to enable USB");
		return 0;
	}

	printk("Bluetooth over USB sample\n");
	return 0;
}
```
